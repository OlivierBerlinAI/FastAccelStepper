/*
 * DualControllerSync - Synchronized dual motor control with separate
 * microcontrollers
 *
 * This example demonstrates how to use FastAccelStepper with two independent
 * microcontrollers, each controlling one motor, using a synchronized start
 * signal.
 *
 * Setup:
 * - Two ESP32 microcontrollers
 * - One motor per microcontroller
 * - Hardware sync signal connected to SYNC_PIN on both controllers
 * - Same command list flashed to both controllers
 * - Each controller configured as LEFT or RIGHT motor
 *
 * Hardware connections:
 * - SYNC_PIN: Connect to same sync signal on both controllers (pulled HIGH to
 * start)
 * - STEP_PIN: Connect to stepper driver STEP pin
 * - DIR_PIN: Connect to stepper driver DIR pin
 * - ENABLE_PIN (optional): Connect to stepper driver ENABLE pin
 */

#include <FastAccelStepper.h>

// ============================================================================
// VERSION INFORMATION
// ============================================================================
#define FIRMWARE_VERSION "v2.1.1-debug"
#define BUILD_DATE __DATE__
#define BUILD_TIME __TIME__

// ============================================================================
// CONFIGURATION - Set this differently for each microcontroller
// ============================================================================

// Define which motor this controller manages
#define MOTOR_LEFT 0
#define MOTOR_RIGHT 1

// **CHANGE THIS FOR EACH MICROCONTROLLER**
#define MOTOR_SIDE MOTOR_LEFT  // or MOTOR_RIGHT for the other controller

// ============================================================================
// PIN CONFIGURATION - Adjust for your hardware
// ============================================================================

#define LEFT_STEP_PIN 19    // GPIO pin for STEP signal
#define LEFT_DIR_PIN 18     // GPIO pin for DIR signal
#define LEFT_ENABLE_PIN 23  // GPIO pin for ENABLE signal

// Microstepping configuration pins
#define MOTOR_MS1 22  // Microstepping MS1 pin
#define MOTOR_MS2 21  // Microstepping MS2 pin

// ============================================================================
// TIMING CONSTRAINTS
// ============================================================================

#define MIN_CMD_TICKS 3200  // ESP32 minimum command duration (200 microseconds)

// ============================================================================
// MOTION COMMAND FORMAT
// ============================================================================

struct MotionCommand {
  int16_t steps_left;       // Steps for LEFT motor
  int16_t steps_right;      // Steps for RIGHT motor
  uint32_t duration_ticks;  // Duration in timer ticks (16MHz for ESP32)
  uint32_t duration_us;     // Duration in microseconds (for debugging/logging)
};

// ============================================================================
// COMMAND LIST - Generated by your external motion planning software
// ============================================================================

// Maximum number of commands that can be stored
#define MAX_COMMANDS 1000

// Command ring buffer (dynamically filled via serial or pre-defined)
MotionCommand motionCommands[MAX_COMMANDS];

// Ring buffer tracking
uint16_t writeIndex = 0;      // Where to write next command
uint16_t readIndex = 0;       // Where to read next command for execution
uint16_t commandCount = 0;    // Number of commands currently in buffer
uint32_t totalCommandsExecuted = 0;  // Total commands executed (for stats)

// Legacy variable for backward compatibility (deprecated)
uint16_t COMMAND_COUNT = 0;

// Example commands (comment out when using serial input)
/*
const MotionCommand defaultCommands[] = {
    {15, 11, 1011929, 63246}, {16, 11, 419155, 26197}, {15, 10, 321629, 20102},
    {15, 11, 271146, 16947},  {16, 11, 238884, 14930}, {15, 11, 215968, 13498},
};
*/

// ============================================================================
// GLOBALS
// ============================================================================

FastAccelStepperEngine engine = FastAccelStepperEngine();
FastAccelStepper* stepper = NULL;

// Execution states
enum ExecutionState {
  STATE_IDLE,           // Waiting for commands
  STATE_READY,          // Commands loaded, waiting for START
  STATE_RUNNING,        // Executing commands
  STATE_COMPLETED       // Execution finished, waiting for restart
};

// Motion execution state
struct {
  ExecutionState state;   // Current execution state
  uint16_t commandIndex;  // Current command being executed
  uint32_t drift;         // Accumulated timing drift (in ticks)
  uint64_t totalTime;     // Total accumulated time (in ticks)
  uint32_t totalSteps;    // Total steps executed
  bool completed;         // All commands completed
  uint64_t startTimeUs;   // Precise start time (microseconds)
  uint64_t endTimeUs;     // Precise end time (microseconds)
} motionState = {STATE_IDLE, 0, 0, 0, 0, false, 0, 0};

// Statistics
struct {
  uint32_t busyCount;      // Number of BUSY returns
  uint32_t emptyCount;     // Number of EMPTY returns (queue ran dry)
  uint32_t notReadyCount;  // Number of DeviceNotReady returns
  uint32_t errorCount;     // Number of errors
  uint32_t maxDrift;       // Maximum drift seen (ticks)
} stats = {0, 0, 0, 0, 0};

// ============================================================================
// HELPER FUNCTIONS
// ============================================================================

// Get the steps for this motor from a command
int16_t getStepsForThisMotor(const MotionCommand& cmd) {
#if MOTOR_SIDE == MOTOR_LEFT
  return cmd.steps_left;
#else
  return cmd.steps_right;
#endif
}

// Get motor name string
const char* getMotorName() {
#if MOTOR_SIDE == MOTOR_LEFT
  return "LEFT";
#else
  return "RIGHT";
#endif
}

// Validate a command
bool validateCommand(const MotionCommand& cmd) {
  int16_t steps = getStepsForThisMotor(cmd);

  // Check minimum duration
  if (cmd.duration_ticks < MIN_CMD_TICKS) {
    Serial.printf("ERROR: Command duration too low: %u < %u\n",
                  cmd.duration_ticks, MIN_CMD_TICKS);
    return false;
  }

  // Check ticks × steps constraint (for non-pause commands)
  if (steps != 0) {
    uint32_t ticks_per_step = cmd.duration_ticks / abs(steps);
    if (ticks_per_step * abs(steps) < MIN_CMD_TICKS) {
      Serial.printf("ERROR: ticks × steps < MIN_CMD_TICKS: %u × %d\n",
                    ticks_per_step, abs(steps));
      return false;
    }
  }

  return true;
}

// ============================================================================
// SERIAL COMMAND PARSER
// ============================================================================

// Read a line from serial (blocks until newline received)
String readSerialLine() {
  String line = "";
  uint32_t startTime = millis();
  const uint32_t timeout = 5000; // 5 second timeout to avoid infinite loops

  while (true) {
    if (Serial.available()) {
      char c = Serial.read();
      if (c == '\n' || c == '\r') {
        if (line.length() > 0) {
          // Consume any trailing \r or \n characters
          delayMicroseconds(1000); // Wait for any trailing chars
          while (Serial.available()) {
            char next = Serial.peek();
            if (next == '\n' || next == '\r') {
              Serial.read(); // Consume it
            } else {
              break; // Stop if we hit actual data
            }
          }
          return line;
        }
        // Ignore empty lines (stray \r or \n)
        // Don't get stuck - just continue
      } else {
        line += c;
        startTime = millis(); // Reset timeout when we get data
      }
    }

    // Timeout protection - don't block forever
    if (millis() - startTime > timeout) {
      if (line.length() > 0) {
        return line; // Return partial line if we have something
      }
      // Return empty string to avoid infinite loop
      return "";
    }

    // Use delayMicroseconds instead of delay to avoid interfering with RMT
    delayMicroseconds(100);
  }
}

// Parse C-style array initializer
// Format: {steps_left, steps_right, duration_ticks, duration_us},
// Can handle multiple commands on one line
int parseArrayInitializers(String line) {
  int commandsAdded = 0;
  int searchStart = 0;
  bool incompleteCommandDetected = false;

  while (searchStart < line.length()) {
    if (commandCount >= MAX_COMMANDS) {
      Serial.printf("ERROR: Command buffer full! (%u/%u commands)\n",
                    commandCount, MAX_COMMANDS);
      break;
    }

    // Find opening brace
    int openBrace = line.indexOf('{', searchStart);
    if (openBrace == -1) {
      break;  // No more commands
    }

    // CRITICAL: Find closing brace BEFORE attempting any parsing
    int closeBrace = line.indexOf('}', openBrace);
    if (closeBrace == -1) {
      // Incomplete command at buffer boundary - STOP PARSING IMMEDIATELY
      incompleteCommandDetected = true;
      Serial.printf("WARNING: Incomplete command detected at position %d - stopping parse\n", openBrace);
      Serial.println("Hint: Data may have been cut off. This is normal for large pastes.");
      break;
    }

    // Only proceed with parsing if we have BOTH braces
    // Extract content between braces
    String content = line.substring(openBrace + 1, closeBrace);
    content.trim();

    // Validate content is not empty
    if (content.length() == 0) {
      Serial.printf("WARNING: Empty command at position %d - skipping\n", openBrace);
      searchStart = closeBrace + 1;
      continue;
    }

    // Parse comma-separated values - ALL 3 commas must be present
    int commaIndex1 = content.indexOf(',');
    int commaIndex2 = content.indexOf(',', commaIndex1 + 1);
    int commaIndex3 = content.indexOf(',', commaIndex2 + 1);

    // VALIDATION: All 3 commas must exist for 4 values
    if (commaIndex1 == -1 || commaIndex2 == -1 || commaIndex3 == -1) {
      Serial.printf("ERROR: Invalid command format at position %d (missing commas) - skipping\n", openBrace);
      Serial.printf("Content: {%s}\n", content.c_str());
      searchStart = closeBrace + 1;
      continue;
    }

    // Extract the 4 fields
    String s_left = content.substring(0, commaIndex1);
    String s_right = content.substring(commaIndex1 + 1, commaIndex2);
    String s_ticks = content.substring(commaIndex2 + 1, commaIndex3);
    String s_us = content.substring(commaIndex3 + 1);

    s_left.trim();
    s_right.trim();
    s_ticks.trim();
    s_us.trim();

    // Validate fields are not empty
    if (s_left.length() == 0 || s_right.length() == 0 ||
        s_ticks.length() == 0 || s_us.length() == 0) {
      Serial.printf("ERROR: Empty field(s) in command at position %d - skipping\n", openBrace);
      searchStart = closeBrace + 1;
      continue;
    }

    // Parse values
    int16_t steps_left = s_left.toInt();
    int16_t steps_right = s_right.toInt();
    uint32_t duration_ticks = s_ticks.toInt();
    uint32_t duration_us = s_us.toInt();

    // Validate parsed values (duration_ticks must be non-zero)
    if (duration_ticks == 0) {
      Serial.printf("ERROR: Invalid duration_ticks=0 at position %d - skipping\n", openBrace);
      Serial.printf("Content: {%s}\n", content.c_str());
      searchStart = closeBrace + 1;
      continue;
    }

    // ALL VALIDATION PASSED - Add to ring buffer at writeIndex
    motionCommands[writeIndex].steps_left = steps_left;
    motionCommands[writeIndex].steps_right = steps_right;
    motionCommands[writeIndex].duration_ticks = duration_ticks;
    motionCommands[writeIndex].duration_us = duration_us;

    Serial.printf("Added command #%u: L=%d R=%d ticks=%lu us=%lu (buffer: %u/%u)\n",
                  totalCommandsExecuted + commandCount, steps_left, steps_right,
                  duration_ticks, duration_us, commandCount + 1, MAX_COMMANDS);

    // Advance writeIndex and increment count
    writeIndex = (writeIndex + 1) % MAX_COMMANDS;
    commandCount++;
    commandsAdded++;

    // Move search position past this command
    searchStart = closeBrace + 1;
  }

  // Report if we stopped due to incomplete data
  if (incompleteCommandDetected && commandsAdded > 0) {
    Serial.printf("INFO: Successfully parsed %d complete commands before incomplete data\n", commandsAdded);
  }

  return commandsAdded;
}

// Parse and add a command from serial
// Format: ADD,steps_left,steps_right,duration_ticks,duration_us
bool addCommandFromSerial(String line) {
  if (commandCount >= MAX_COMMANDS) {
    Serial.printf("ERROR: Command buffer full! (%u/%u commands)\n",
                  commandCount, MAX_COMMANDS);
    return false;
  }

  // Parse CSV format
  int commaIndex1 = line.indexOf(',');
  int commaIndex2 = line.indexOf(',', commaIndex1 + 1);
  int commaIndex3 = line.indexOf(',', commaIndex2 + 1);
  int commaIndex4 = line.indexOf(',', commaIndex3 + 1);

  if (commaIndex1 == -1 || commaIndex2 == -1 || commaIndex3 == -1 || commaIndex4 == -1) {
    Serial.println("ERROR: Invalid format. Use: ADD,steps_left,steps_right,duration_ticks,duration_us");
    return false;
  }

  String cmd = line.substring(0, commaIndex1);
  if (cmd != "ADD") {
    return false;  // Not an ADD command
  }

  int16_t steps_left = line.substring(commaIndex1 + 1, commaIndex2).toInt();
  int16_t steps_right = line.substring(commaIndex2 + 1, commaIndex3).toInt();
  uint32_t duration_ticks = line.substring(commaIndex3 + 1, commaIndex4).toInt();
  uint32_t duration_us = line.substring(commaIndex4 + 1).toInt();

  // Add to ring buffer at writeIndex
  motionCommands[writeIndex].steps_left = steps_left;
  motionCommands[writeIndex].steps_right = steps_right;
  motionCommands[writeIndex].duration_ticks = duration_ticks;
  motionCommands[writeIndex].duration_us = duration_us;

  Serial.printf("Added command #%u: L=%d R=%d ticks=%lu us=%lu (buffer: %u/%u)\n",
                totalCommandsExecuted + commandCount, steps_left, steps_right,
                duration_ticks, duration_us, commandCount + 1, MAX_COMMANDS);

  // Advance writeIndex and increment count
  writeIndex = (writeIndex + 1) % MAX_COMMANDS;
  commandCount++;

  return true;
}

// Process serial commands (truly non-blocking)
void processSerialCommands() {
  static String inputBuffer = "";

  // Read available characters without blocking
  while (Serial.available()) {
    char c = Serial.read();

    if (c == '\n' || c == '\r') {
      // End of line - process if we have data
      if (inputBuffer.length() > 0) {
        String line = inputBuffer;
        inputBuffer = "";  // Clear buffer for next command
        line.trim();

        if (line.length() == 0) {
          continue; // Skip empty lines
        }

        // Process the command (moved processing code here)
        processCommand(line);
      }
      // Ignore empty lines (trailing \r\n)
    } else {
      inputBuffer += c;
    }
  }
}

// Process a single command line
void processCommand(String line) {

  // Handle commands based on current state

  // Try to parse as C-style array initializer first: {val1, val2, val3, val4},
  if (line.indexOf('{') != -1) {
    int added = parseArrayInitializers(line);
    if (added > 0) {
      Serial.printf("Total commands added: %d (buffer: %u/%u)\n",
                    added, commandCount, MAX_COMMANDS);
      if (motionState.state == STATE_IDLE) {
        motionState.state = STATE_READY;
      }
    }
  } else if (line.startsWith("ADD,")) {
    if (addCommandFromSerial(line)) {
      if (motionState.state == STATE_IDLE) {
        motionState.state = STATE_READY;
      }
    }
  } else if (line.equalsIgnoreCase("CLEAR")) {
    if (motionState.state == STATE_RUNNING) {
      Serial.println("ERROR: Cannot clear commands while executing. Wait for completion or send STOP.");
    } else {
      // Reset ring buffer
      writeIndex = 0;
      readIndex = 0;
      commandCount = 0;
      totalCommandsExecuted = 0;
      COMMAND_COUNT = 0;  // Legacy
      motionState.state = STATE_IDLE;
      // Reset statistics
      stats.busyCount = 0;
      stats.emptyCount = 0;
      stats.notReadyCount = 0;
      stats.errorCount = 0;
      stats.maxDrift = 0;
      Serial.println("Command buffer cleared. Ready for new commands.");
    }
  } else if (line.equalsIgnoreCase("STATUS")) {
    Serial.printf("Commands queued: %u / %u\n", commandCount, MAX_COMMANDS);
    Serial.printf("Commands executed: %u\n", totalCommandsExecuted);
    Serial.printf("State: ");
    switch (motionState.state) {
      case STATE_IDLE: Serial.println("IDLE (waiting for commands)"); break;
      case STATE_READY: Serial.println("READY (send START to execute)"); break;
      case STATE_RUNNING: Serial.println("RUNNING (executing commands)"); break;
      case STATE_COMPLETED: Serial.println("COMPLETED (send CLEAR for new sequence)"); break;
    }
  } else if (line.equalsIgnoreCase("START")) {
    if (motionState.state == STATE_RUNNING) {
      Serial.println("ERROR: Already running!");
    } else if (commandCount == 0) {
      Serial.println("ERROR: No commands loaded. Add commands first.");
    } else if (motionState.state == STATE_COMPLETED) {
      Serial.println("ERROR: Previous execution completed. Send CLEAR first, then add new commands.");
    } else {
      Serial.printf("Starting execution with %u commands...\n", commandCount);
      startExecution();
    }
  } else if (line.equalsIgnoreCase("STOP")) {
    if (motionState.state == STATE_RUNNING) {
      stepper->forceStopAndNewPosition(stepper->getCurrentPosition());
      motionState.state = STATE_COMPLETED;
      motionState.completed = true;
      Serial.println("Execution stopped!");
    } else {
      Serial.println("Not currently running.");
    }
  } else if (line.equalsIgnoreCase("STATS")) {
    // Return JSON stats for buffer status (used for polling)
    Serial.print("{");
    Serial.printf("\"bufferSize\":%u,", MAX_COMMANDS);
    Serial.printf("\"commandsQueued\":%u,", commandCount);
    Serial.printf("\"commandsFree\":%u,", MAX_COMMANDS - commandCount);
    Serial.printf("\"commandsExecuted\":%u,", totalCommandsExecuted);
    Serial.printf("\"state\":\"%s\",",
                  motionState.state == STATE_IDLE ? "IDLE" :
                  motionState.state == STATE_READY ? "READY" :
                  motionState.state == STATE_RUNNING ? "RUNNING" : "COMPLETED");
    Serial.printf("\"queueEmpty\":%s,", commandCount == 0 ? "true" : "false");
    Serial.printf("\"totalSteps\":%lu,", motionState.totalSteps);
    Serial.printf("\"drift\":%ld", (int32_t)motionState.drift);
    Serial.println("}");
  } else if (line.equalsIgnoreCase("HELP")) {
    printHelp();
  } else {
    Serial.printf("Unknown command: %s (type HELP for commands)\n", line.c_str());
  }
}

// Print help message
void printHelp() {
  Serial.println("\n========================================");
  Serial.println("  Serial Command Mode");
  Serial.println("========================================");
  Serial.println("Commands:");
  Serial.println("  ADD,steps_left,steps_right,duration_ticks,duration_us");
  Serial.println("  {steps_left, steps_right, duration_ticks, duration_us},");
  Serial.println("  CLEAR              - Clear all commands");
  Serial.println("  STATUS             - Show status and command count");
  Serial.println("  STATS              - Show buffer stats as JSON");
  Serial.println("  START              - Begin execution");
  Serial.println("  STOP               - Stop current execution");
  Serial.println("  HELP               - Show this help");
  Serial.println("========================================");
  Serial.println("Examples:");
  Serial.println("  ADD,100,50,1600000,100000");
  Serial.println("  {100, 50, 1600000, 100000},");
  Serial.println("  {-50, -25, 800000, 50000},");
  Serial.println("========================================");
  Serial.println("Note: Commands can be added while motor is RUNNING");
  Serial.println("Use STATS to poll buffer capacity for streaming");
  Serial.println("========================================\n");
}

// Print status (called periodically)
void printStatus() {
  static uint32_t lastPrint = 0;
  uint32_t now = millis();

  if (now - lastPrint >= 1000) {  // Print every 1 second
    lastPrint = now;

    Serial.printf(
        "[%s] Executed:%u Queued:%u/%u Steps:%lu Time:%luus Drift:%ld "
        "Busy:%lu Empty:%lu NR:%lu Err:%lu\n",
        getMotorName(), totalCommandsExecuted, commandCount, MAX_COMMANDS,
        motionState.totalSteps,
        (uint32_t)(motionState.totalTime / 16),  // Convert ticks to us
        (int32_t)motionState.drift, stats.busyCount, stats.emptyCount,
        stats.notReadyCount, stats.errorCount);
  }
}

// Execute one command from the ring buffer
void executeNextCommand() {
  // Check if ring buffer is empty
  if (commandCount == 0) {
    if (!motionState.completed) {
      motionState.completed = true;
      motionState.state = STATE_COMPLETED;

      // Capture precise end time
      motionState.endTimeUs = esp_timer_get_time();
      uint64_t actualDurationUs = motionState.endTimeUs - motionState.startTimeUs;

      Serial.println("\n=== All commands completed ===");
      Serial.printf("Total commands executed: %u\n", totalCommandsExecuted);
      Serial.printf("Total steps: %lu\n", motionState.totalSteps);
      Serial.printf("Total time: %lu us\n",
                    (uint32_t)(motionState.totalTime / 16));
      Serial.printf("Final drift: %ld ticks (%ld us)\n",
                    (int32_t)motionState.drift,
                    (int32_t)motionState.drift / 16);
      Serial.printf("Max drift: %lu ticks (%lu us)\n", stats.maxDrift,
                    stats.maxDrift / 16);
      Serial.printf("Stats - Busy:%lu Empty:%lu NotReady:%lu Errors:%lu\n",
                    stats.busyCount, stats.emptyCount, stats.notReadyCount,
                    stats.errorCount);
      Serial.println();
      Serial.println("========================================");
      Serial.printf("PRECISE TIMER: %llu microseconds\n", actualDurationUs);
      Serial.printf("PRECISE TIMER: %llu.%06llu seconds\n",
                    actualDurationUs / 1000000,
                    actualDurationUs % 1000000);
      Serial.println("========================================");
      Serial.println();
      Serial.println("** Compare this value between LEFT and RIGHT controllers **");
      Serial.println("** Both should show EXACTLY the same PRECISE TIMER value **");
      Serial.println();
      Serial.println("Send CLEAR to load new commands, or STATUS to check state.");
    }
    return;
  }

  // Get current command from ring buffer at readIndex
  const MotionCommand& cmd = motionCommands[readIndex];
  int16_t steps = getStepsForThisMotor(cmd);

  // Apply drift compensation
  uint32_t duration = cmd.duration_ticks + motionState.drift;
  uint32_t actual = 0;

  // Execute the timed move
  // IMPORTANT: Use start_immediately=false because queue was already started
  // in startExecution(). We're just adding commands to the running queue.
  MoveTimedResultCode rc = stepper->moveTimed(steps, duration, &actual, false);

  // DEBUG: Print what moveTimed returns for troubleshooting
  static uint32_t debugCount = 0;
  if (debugCount < 50) {  // Print first 50 to see the pattern
    Serial.printf("DEBUG: executeNextCommand() called, commandCount=%u, moveTimed() returned: %s (actual=%lu)\n",
                  commandCount, toString(rc), actual);
    debugCount++;
  }

  switch (rc) {
    case MOVE_TIMED_OK:
      // Command successfully queued - advance ring buffer
      motionState.drift = duration - actual;
      motionState.totalTime += actual;
      motionState.totalSteps += abs(steps);

      // Advance readIndex and decrement count
      readIndex = (readIndex + 1) % MAX_COMMANDS;
      commandCount--;
      totalCommandsExecuted++;
      motionState.commandIndex++;  // For backward compatibility

      // Track max drift
      if (abs((int32_t)motionState.drift) > stats.maxDrift) {
        stats.maxDrift = abs((int32_t)motionState.drift);
      }
      break;

    case MOVE_TIMED_EMPTY:
      // Queue ran dry, but command was added - advance ring buffer
      Serial.printf("WARNING: Queue empty at command %u\n", totalCommandsExecuted);
      stats.emptyCount++;

      motionState.drift = duration - actual;
      motionState.totalTime += actual;
      motionState.totalSteps += abs(steps);

      // Advance readIndex and decrement count
      readIndex = (readIndex + 1) % MAX_COMMANDS;
      commandCount--;
      totalCommandsExecuted++;
      motionState.commandIndex++;  // For backward compatibility

      if (abs((int32_t)motionState.drift) > stats.maxDrift) {
        stats.maxDrift = abs((int32_t)motionState.drift);
      }
      break;

    case MOVE_TIMED_BUSY:
      // Queue doesn't have room, retry next loop
      stats.busyCount++;
      break;

    case MoveTimedResultCode::DeviceNotReady:
      // RMT peripheral still initializing, retry next loop
      // This is normal right after starting the queue
      stats.notReadyCount++;
      delayMicroseconds(10);  // Small delay to let peripheral initialize
      break;

    case MOVE_TIMED_TOO_LARGE_ERROR:
      Serial.printf("ERROR: Command %u too large (steps=%d, duration=%lu)\n",
                    totalCommandsExecuted, steps, cmd.duration_ticks);
      stats.errorCount++;

      // Skip this command - advance ring buffer
      readIndex = (readIndex + 1) % MAX_COMMANDS;
      commandCount--;
      totalCommandsExecuted++;
      motionState.commandIndex++;  // For backward compatibility
      break;

    case MoveTimedResultCode::ErrorTicksTooLow:
      Serial.printf("ERROR: Command %u ticks too low (steps=%d, duration=%lu)\n",
                    totalCommandsExecuted, steps, cmd.duration_ticks);
      stats.errorCount++;

      // Skip this command - advance ring buffer
      readIndex = (readIndex + 1) % MAX_COMMANDS;
      commandCount--;
      totalCommandsExecuted++;
      motionState.commandIndex++;  // For backward compatibility
      break;

    default:
      Serial.printf("ERROR: Command %u failed with code: %s\n",
                    totalCommandsExecuted, toString(rc));
      stats.errorCount++;

      // Skip this command - advance ring buffer
      readIndex = (readIndex + 1) % MAX_COMMANDS;
      commandCount--;
      totalCommandsExecuted++;
      motionState.commandIndex++;  // For backward compatibility
      break;
  }
}

// Start execution (validate, pre-fill, and start queue)
void startExecution() {
  // Reset execution state
  motionState.commandIndex = 0;
  motionState.drift = 0;
  motionState.totalTime = 0;
  motionState.totalSteps = 0;
  motionState.completed = false;
  motionState.startTimeUs = 0;
  motionState.endTimeUs = 0;

  // Reset statistics
  stats.busyCount = 0;
  stats.emptyCount = 0;
  stats.notReadyCount = 0;
  stats.errorCount = 0;
  stats.maxDrift = 0;

  // Validate commands currently in ring buffer
  Serial.println("\nValidating command list...");
  bool allValid = true;
  uint16_t validateIndex = readIndex;
  for (uint16_t i = 0; i < commandCount; i++) {
    if (!validateCommand(motionCommands[validateIndex])) {
      Serial.printf("ERROR: Command %u failed validation\n", i);
      allValid = false;
    }
    validateIndex = (validateIndex + 1) % MAX_COMMANDS;
  }

  if (!allValid) {
    Serial.println("ERROR: Command validation failed!");
    motionState.state = STATE_READY;  // Stay in ready state
    return;
  }
  Serial.printf("All %u commands validated successfully.\n\n", commandCount);

  // Add first command and start queue immediately
  // This ensures RMT peripheral is initialized and running
  // All subsequent commands will be added by executeNextCommand()
  Serial.println("Starting queue with first command...");

  const MotionCommand& firstCmd = motionCommands[readIndex];
  int16_t firstSteps = getStepsForThisMotor(firstCmd);

  // Add first command without starting
  MoveTimedResultCode rc = stepper->moveTimed(firstSteps, firstCmd.duration_ticks, NULL, false);
  if (rc != MOVE_TIMED_OK && rc != MOVE_TIMED_EMPTY) {
    Serial.printf("ERROR: Failed to add first command: %s\n", toString(rc));
    motionState.state = STATE_READY;
    return;
  }

  // NOW start the queue
  stepper->moveTimed(0, 0, NULL, true);  // Start the queue NOW

  // Advance ring buffer to mark first command as queued
  readIndex = (readIndex + 1) % MAX_COMMANDS;
  commandCount--;

  // Capture precise start time immediately after starting queue
  motionState.startTimeUs = esp_timer_get_time();

  Serial.println("Motion execution started!\n");
  Serial.printf("TIMER STARTED at: %llu us\n\n", motionState.startTimeUs);
  Serial.printf("Ring buffer: %u commands remaining (can add more while running)\n\n",
                commandCount);

  // Change state to running
  motionState.state = STATE_RUNNING;
}

// ============================================================================
// ARDUINO SETUP
// ============================================================================

void setup() {
  // Increase serial buffer size to handle large command pastes
  Serial.setRxBufferSize(8192);  // 8KB buffer for large command lists

  Serial.begin(115200);
  delay(1000);  // Wait for serial to initialize

  Serial.println("\n\n=================================================");
  Serial.println("FastAccelStepper - Dual Controller Sync Example");
  Serial.println("=================================================");
  Serial.printf("Firmware Version: %s\n", FIRMWARE_VERSION);
  Serial.printf("Build Date: %s %s\n", BUILD_DATE, BUILD_TIME);
  Serial.println("-------------------------------------------------");
  Serial.printf("Motor side: %s\n", getMotorName());
  Serial.printf("Ring buffer capacity: %u commands\n", MAX_COMMANDS);
  Serial.printf("Step pin: %d\n", LEFT_STEP_PIN);
  Serial.printf("Dir pin: %d\n", LEFT_DIR_PIN);
  Serial.printf("Enable pin: %d\n", LEFT_ENABLE_PIN);
  Serial.printf("Microstepping MS1: %d\n", MOTOR_MS1);
  Serial.printf("Microstepping MS2: %d\n", MOTOR_MS2);
  Serial.println("=================================================\n");

  // Configure microstepping pins
  pinMode(MOTOR_MS1, OUTPUT);
  pinMode(MOTOR_MS2, OUTPUT);
  digitalWrite(MOTOR_MS1, LOW);  // Set microstepping mode
  digitalWrite(MOTOR_MS2,
               LOW);  // LOW/LOW = full step or 1/2 step depending on driver
  Serial.println("Microstepping configured (MS1=LOW, MS2=LOW)");

  // Initialize FastAccelStepper engine
  engine.init();
  stepper = engine.stepperConnectToPin(LEFT_STEP_PIN);

  if (!stepper) {
    Serial.println("ERROR: Failed to initialize stepper!");
    while (1) {
      delay(1000);
    }
  }

  // Configure stepper
  stepper->setDirectionPin(LEFT_DIR_PIN);
  stepper->setEnablePin(LEFT_ENABLE_PIN);
  stepper->setAutoEnable(false);  // Manual enable control for better timing

  Serial.println("Stepper initialized successfully.");

  // Manually enable the stepper driver
  stepper->enableOutputs();
  Serial.println("Stepper driver enabled.");

  // Wait for stepper driver to stabilize (important!)
  delay(100);  // 100ms delay for driver to wake up
  Serial.println("Driver stabilization delay complete.\n");

  // Print help and wait for commands
  printHelp();
  Serial.println("Ready! Send commands to begin.");
  Serial.println("Type HELP for command list.\n");
}

// ============================================================================
// ARDUINO LOOP
// ============================================================================

void loop() {
  // DEBUG: Verify loop is running
  static uint32_t loopDebugCount = 0;
  if (loopDebugCount < 5 && motionState.state == STATE_RUNNING) {
    Serial.printf("DEBUG: loop() iteration #%lu, state=RUNNING\n", loopDebugCount);
    loopDebugCount++;
  }

  // Always process serial commands
  processSerialCommands();

  // Execute commands if in RUNNING state
  if (motionState.state == STATE_RUNNING) {
    executeNextCommand();
    printStatus();
  }

  // No delay - run as fast as possible to keep FAS queue fed
  // delay() can interfere with RMT peripheral on ESP32
}
